#include <behaviors.dtsi>
#include <behaviors/num_word.dtsi> // Requires zmk-auto-layer module.
#include <behaviors/unicode.dtsi> // Requires zmk-unicode module.
#include <zmk-helpers/helper.h> // Requires zmk-helpers module.
#include <dt-bindings/zmk/keys.h>
#ifdef CONFIG_WIRELESS
  #include <dt-bindings/zmk/bt.h>
  #include <dt-bindings/zmk/outputs.h>
  #define _BT_SEL_KEYS_                                                        \
      &bt BT_SEL 0 &bt BT_SEL 1 &bt BT_SEL 2 &bt BT_SEL 3 &bt BT_CLR
#else
  #define _BT_SEL_KEYS_ &trans &trans &trans &trans &trans
#endif

#include "zmk-helpers/helper.h"
#include "zmk-helpers/unicode-chars/greek.dtsi"
#include "zmk-helpers/unicode-chars/german.dtsi"

#define XXX &none
#define ___ &trans

/* Global defaults */

#define QUICK_TAP_MS 175

&num_word {
  continue-list = <BSPC DEL DOT COMMA COLON PLUS MINUS SLASH ASTERISK KP_PLUS KP_MINUS KP_SLASH KP_ASTERISK LALT LSHFT LCTRL LGUI RGUI RCTRL RSHFT RALT>;
};

// For oneshot layer
&sk {
  release-after-ms = <2000>;
  quick-release;
};

// NOTE: this forces you pause after one using oneshot on a hrm if you then want to click a hrm for the key.
// &sl { // Allow sticky mods to chord across sticky layers.
//   ignore-modifiers;
// };

&lt {
  flavor = "balanced";
  tapping-term-ms = <200>;
  quick-tap-ms = <QUICK_TAP_MS>;
};

/ {
  behaviors {
    snake_word: snake_word {
      compatible = "zmk,behavior-auto-layer";
      #binding-cells = <1>;
      continue-list = <Q W E R T Y U I O P A S D F G H J K L Z X C V B N M UNDER>;
      ignore-modifiers;
    };
    // Need this because if I tap shift, then another key to capitalize, then space,
    // sentence layer gets triggered and my spaces cause dots.
    sentence_auto_layer: sentence_auto_layer {
      compatible = "zmk,behavior-auto-layer";
      #binding-cells = <1>;
      continue-list = <DOT>;
    };
    sl_fast: sticky_layer_fast {
      compatible = "zmk,behavior-sticky-key";
      #binding-cells = <1>;
      release-after-ms = <400>;
      bindings = <&mo>;
      quick-release;
    };
    sl_slow: sticky_layer_slow {
      compatible = "zmk,behavior-sticky-key";
      #binding-cells = <1>;
      release-after-ms = <2000>;
      bindings = <&mo>;
      quick-release;
    };
  };
};


/* Layers */

/ {
    behaviors {
        tog_on: toggle_layer_on_only {
            compatible = "zmk,behavior-toggle-layer";
            #binding-cells = <1>;
            display-name = "Toggle Layer On";
            toggle-mode = "on";
        };
        tog_off: toggle_layer_off_only {
            compatible = "zmk,behavior-toggle-layer";
            #binding-cells = <1>;
            display-name = "Toggle Layer Off";
            toggle-mode = "off";
        };
    };
};

#define DEF 0
#define QWERTY 1
#define LEFTSHIFT 2
#define NUM 3
#define FN 4
#define NAV 5
#define SYS 6
#define MOUSE 7
#define MOUSE_BTNS 8
#define MIRROR 9
#define NUM_MIRROR 10
#define ONESHOT 11
#define SNAKE 12
#define NOIDLE 13 
#define SENTENCE 14 
#define GAME 15
#define MCRFT 16
#define GAME_NUM 17


#define ALL_LAYERS \
  DEF QWERTY LEFTSHIFT NUM FN NAV SYS MOUSE MOUSE_BTNS MIRROR ONESHOT NUM_MIRROR SNAKE NOIDLE SENTENCE

// also not including ONESHOT
#define NOT_MIRROR \
  DEF QWERTY LEFTSHIFT NUM FN NAV SYS MOUSE MOUSE_BTNS SNAKE NOIDLE SENTENCE

// also not including ONESHOT
#define NOT_MIRR_FN_MBTNS \ 
  DEF QWERTY LEFTSHIFT NUM NAV SYS MOUSE SNAKE NOIDLE SENTENCE

#define LAYER_LIST \
  LL(DEF,        0,  F20)  \
  LL(QWERTY,     1,  F21)  \
  LL(LEFTSHIFT,  2,  F22)  \
  LL(NUM,        3,  F23)  \
  LL(FN,         4,  F24)  \
  LL(NAV,        5,  F15)  \
  LL(SYS,        6,  F16)  \
  LL(MOUSE,      7,  F17)  \
  LL(MOUSE_BTNS, 8,  F18)  \
  LL(ONESHOT,    11, F19)  \
  LL(GAME,       15, F13)  \
  LL(MCRFT,      16, F14)

// fkey: temp toggle (eg. numword, capsword, etc.)
// shift fkey: tog on
// ctrl fkey: tog off
// ctrl shift fkey: tog on/off

// helper macro to emit both on/off for a single entry
#define LL(name, layer, fn)                                                  \
    ZMK_MACRO(temp_tog_signal_##name##,  bindings = <&kp fn>;                \
            wait-ms = <0>; tap-ms = <0>;)                                    \
    ZMK_MACRO(tog_on_##name##,  bindings = <&kp LS(fn) &tog_on layer>;       \
            wait-ms = <0>; tap-ms = <0>;)                                    \
    ZMK_MACRO(tog_off_##name##, bindings = <&kp LC(fn) &tog_off layer>;      \
            wait-ms = <0>; tap-ms = <0>;)                                    \
    ZMK_MACRO(tog_##name##, bindings = <&kp LC(LS(fn)) &tog layer>;          \
            wait-ms = <0>; tap-ms = <0>;)                                    \
    ZMK_MACRO(sl_##name##, bindings = <&temp_tog_signal_##name## &sl layer>; \
            wait-ms = <0>; tap-ms = <0>;)                                    \
    ZMK_MACRO(lt_##name##, bindings = <&temp_tog_signal_##name## &sl layer>; \
            wait-ms = <0>; tap-ms = <0>;)

// expand the whole list
LAYER_LIST

// clean up
#undef LL

ZMK_MACRO(num_word_with_signal, bindings = <&temp_tog_signal_NUM &num_word NUM>; \
           wait-ms = <0>; tap-ms = <0>;)

// ZMK_MACRO(tog_num_on, bindings = <&kp F_NUM &tog NUM>; wait-ms = <0>; tap-ms = <5>;)
// ZMK_MACRO(tog_num_off, bindings = <&kp LS(F_NUM) &tog NUM>; wait-ms = <0>; tap-ms = <5>;)

/* Homerow mods */

#define KEYS_L LT0 LT1 LT2 LT3 LT4 LT5 LM0 LM1 LM2 LM3 LM4 LM5 LB0 LB1 LB2 LB3 LB4 LB5
#define KEYS_R RT0 RT1 RT2 RT3 RT4 RT5 RM0 RM1 RM2 RM3 RM4 RM5 RB0 RB1 RB2 RB3 RB4 RB5
#define THUMBS LH2 LH1 LH0 RH0 RH1 RH2 // Thumbs on 36+ keys.

// #ifndef LH2
//   #define THUMBS LH1 LH0 RH0 RH1         // Thumbs on 34 keys.
// #else
//   #define THUMBS LH2 LH1 LH0 RH0 RH1 RH2 // Thumbs on 36+ keys.
// #endif


// NOTE: hold-while-undecided makes mods work well with mouse but causes immediate mod tap on home row keys
// this makes tapping alt all the time causing menu bars to appear
#define MAKE_HRM(NAME, HOLD, TAP, TRIGGER_POS)                                 \
  ZMK_HOLD_TAP(NAME, bindings = <HOLD>, <TAP>; flavor = "balanced";            \
               tapping-term-ms = <260>; quick-tap-ms = <QUICK_TAP_MS>;         \
               hold-trigger-on-release;                                        \
               hold-trigger-key-positions = <TRIGGER_POS>;                     \
               )
               // require-prior-idle-ms = <100>; 

MAKE_HRM(hml, &kp, &kp, KEYS_R THUMBS) // Left-hand HRMs.
MAKE_HRM(hmr, &kp, &kp, KEYS_L THUMBS) // Right-hand HRMs.


// NOTE: needed for using s+/ to do ? afer clicking the s button.
// With quick-tap-ms, as macro above, it does ss/ (eg thiss/ instead of this?)
// HOWEVER, this causes double tap hm key to spam the key no work
#define MAKE_HRM_NO_QUICK(NAME, HOLD, TAP, TRIGGER_POS)                            \
  ZMK_HOLD_TAP(NAME, bindings = <HOLD>, <TAP>; flavor = "balanced";            \
               tapping-term-ms = <260>; hold-trigger-on-release;               \
               hold-trigger-key-positions = <TRIGGER_POS>;                     \
               hold-while-undecided;                                            \
               )

MAKE_HRM_NO_QUICK(hml2, &kp, &kp, KEYS_R THUMBS)
MAKE_HRM_NO_QUICK(hmr2, &kp, &kp, KEYS_L THUMBS)

// No idle hrm for the ability to use mods immediately after pressing certain keys.
// TODO: Won't need this once there is an exception list for require-prior-idle-ms: https://github.com/zmkfirmware/zmk/issues/2400
// For some reason causes thumb keys to not work when held immediately after spc or bspc
#define MAKE_HRM_NO_IDLE(NAME, HOLD, TAP, TRIGGER_POS)                         \
  ZMK_HOLD_TAP(NAME, bindings = <HOLD>, <TAP>; flavor = "balanced";            \
               tapping-term-ms = <230>; quick-tap-ms = <QUICK_TAP_MS>;         \
               hold-trigger-on-release;                                        \
               hold-trigger-key-positions = <TRIGGER_POS>;                     \
               )

MAKE_HRM_NO_IDLE(hml_no_idle, &kp, &kp, KEYS_R THUMBS) 
MAKE_HRM_NO_IDLE(hmr_no_idle, &kp, &kp, KEYS_L THUMBS) 

ZMK_MACRO(spc_then_noidle, bindings = <&kp SPACE &sl NOIDLE>; \
           wait-ms = <0>; tap-ms = <5>;)
ZMK_MACRO(bspc_then_noidle, bindings = <&kp BSPC &sl NOIDLE>; \
           wait-ms = <0>; tap-ms = <5>;)

ZMK_HOLD_TAP(lt_spc_noidle, bindings = <&mo>, <&spc_then_noidle>; flavor = "balanced";
             tapping-term-ms = <200>; quick-tap-ms = <QUICK_TAP_MS>;)


// ZMK_MACRO(spc, bindings = <&kp SPACE>; \
//            wait-ms = <0>; tap-ms = <5>;)
// ZMK_MACRO(bspc, bindings = <&kp BSPC>; \
//            wait-ms = <0>; tap-ms = <5>;)

// ZMK_HOLD_TAP(lt_fn_spc_noidle,
//   bindings = <&mo FN &spc_then_noidle>; 
//   flavor = "tap-preferred";
//   tapping-term-ms = <230>;
//   quick-tap-ms = <200>;
//   hold-trigger-on-release;
// )

// Hack: Make HRM combos tap-only (cf, ZMK issue #544).
#define ZMK_COMBO_8(NAME, TAP, POS, LAYERS, COMBO_MS, IDLE_MS, HOLD, SIDE)     \
  MAKE_HRM(hm_combo_##NAME, &kp, TAP, SIDE THUMBS)                             \
  ZMK_COMBO_6(NAME, &hm_combo_##NAME HOLD 0, POS, LAYERS, COMBO_MS, IDLE_MS)

/* Combos, leader key sequences, mouse emulation */

#include "combos.dtsi" // Must be sourced after HRM-combo hack.
#include "leader.dtsi"
#include "mouse.dtsi"

/* Nav cluster */

// Trigger tap-action on all interrupts.
#define MT_CORE                                                                \
  flavor = "tap-preferred";                                                    \
  tapping-term-ms = <220>;                                                     \
  quick-tap-ms = <220>;                                                        \
  hold-trigger-key-positions = <0>;

&mt { MT_CORE };

ZMK_HOLD_TAP(mt_home, bindings = <&masked_home>, <&kp>; MT_CORE)
ZMK_HOLD_TAP(mt_end, bindings = <&masked_end>, <&kp>; MT_CORE)

#define NAV_LEFT  &mt_home 0   LEFT  // Tap: left  | Long-tap: start of line.
#define NAV_RIGHT &mt_end 0    RIGHT // Tap: right | Long-tap: end   of line.
#define NAV_UP    &mt LC(HOME) UP    // Tap: up    | Long-tap: start of doc.
#define NAV_DOWN  &mt LC(END)  DOWN  // Tap: down  | Long-tap: end   of doc.
#define NAV_BSPC  &mt LC(BSPC) BSPC  // Tap: bspc  | Long-tap: delete word bwd.
#define NAV_DEL   &mt LC(DEL)  DEL   // Tap: del   | Long-tap: delete word fwd.

// Mask CTRL on left/right hold to avoid accidental jumps to start/end of doc.
#define MASK_MODS(NAME, MODS, BINDING)                                         \
  ZMK_MOD_MORPH(NAME, bindings = <BINDING>, <BINDING>; mods = <MODS>;)

MASK_MODS(masked_home, (MOD_LCTL), &kp HOME)
MASK_MODS(masked_end,  (MOD_LCTL), &kp END)

/* Magic-shift & auto-layers */

// Tap: sticky-shift, if after alpha and spc pressed: dot + space + sticky-shift
// Shift + tap/ double-tap: caps-word | Hold: shift.
#define MAGIC_SHIFT &magic_shift LSHFT 0
ZMK_HOLD_TAP(magic_shift, bindings = <&kp>, <&magic_shift_tap>;
             flavor = "balanced"; tapping-term-ms = <200>;
             quick-tap-ms = <QUICK_TAP_MS>;)

// MAGIC SENTENCE DISABLED FOR NOW
// ZMK_MOD_MORPH(magic_shift_tap, bindings = <&magic_sentence>, <&caps_word>;
//               mods = <(MOD_LSFT)>;)
ZMK_MOD_MORPH(magic_shift_tap, bindings = <&sk LSHFT>, <&caps_word>;
              mods = <(MOD_LSFT)>;)
ZMK_MACRO(magic_sentence,
    wait-ms = <0>; tap-ms = <5>;
    bindings = <&sk LSHFT &sl SENTENCE>;
)

&caps_word { // Mods deactivate caps-word, requires PR #1451. [TODO: rebase]
  /delete-property/ ignore-modifiers;
};

// Tap: num-word | double-tap: toggle num-layer | Hold: num-layer.
#define SMART_NUM &smart_num NUM 0
ZMK_HOLD_TAP(smart_num, bindings = <&mo>, <&num_dance>; flavor = "balanced";
             tapping-term-ms = <200>; quick-tap-ms = <QUICK_TAP_MS>;)
ZMK_TAP_DANCE(num_dance, bindings = <&num_word NUM>, <&tog_on_NUM>;
              tapping-term-ms = <200>;)
// NOTE: having the signal messes with ONESHOT layer: sending the f-key forces the "quick-release" of &sk, causing the upstroke of MOD to come,
// before its possible to press the desired numkey.
// ZMK_TAP_DANCE(num_dance, bindings = <&num_word_with_signal>, <&tog_on_NUM>;
//               tapping-term-ms = <200>;)

// Smart-mouse, requires tri-state module.
ZMK_TRI_STATE(
    smart_mouse, bindings = <&tog_on_MOUSE>, <&none>, <&tog_off_MOUSE>;
    ignored-key-positions =
        // <    LT1 LT2 LH0 LH1 LH2 RT1 RT2 RT3 RM0 RM1 RM2 RM3 RM4 RB1 RB2 RB3 RH0 RH1>;
        // <       LT3 LT2 LT1             RT1 RT2 RT3 
        //     LM4 LM3 LM2 LM1 LM0     RM0 RM1 RM2 RM3 RM4 
        //         LB3 LB2 LB1             RB1 RB2 RB3 
        //             LH2             RH0     RH2>;
        <       LT3 LT2 LT1             RT1 RT2 RT3 
            LM4 LM3 LM2 LM1 LM0     RM0 RM1 RM2 RM3 RM4 
                LB3 LB2 LB1             RB1 RB2 RB3 
                    LH2             RH0     RH2>;
    ignored-layers = <MOUSE NAV FN>;)


/* Custom behaviors */

// Alt+Tab swapper, requires tri-state module.
ZMK_TRI_STATE(swapper, bindings = <&kt LALT>, <&kp TAB>, <&kt LALT>;
              ignored-key-positions = <LT2 RT2 RM1 RM2 RM3>;)

// Define mod-morph with a *single* mod trigger for less repetition.
#define SIMPLE_MORPH(NAME, MOD, BINDING1, BINDING2)                            \
  ZMK_MOD_MORPH(NAME, mods = <(MOD_L##MOD | MOD_R##MOD)>;                      \
                bindings = <BINDING1>, <BINDING2>;)

// Tap: comma | Shift + tap: semicolon | Ctrl + shift + tap: <.
SIMPLE_MORPH(comma_morph, SFT, &kp COMMA, &comma_inner_morph)
SIMPLE_MORPH(comma_inner_morph, CTL, &kp SEMICOLON, &kp LESS_THAN)

// Tap: qmark | Shift + tap: excl.
SIMPLE_MORPH(qexcl, SFT, &kp QMARK, &kp EXCL)

// Tap: left/right parenthesis | Shft + tap: less-than/greater-than.
SIMPLE_MORPH(lpar_lt, SFT, &kp LPAR, &kp LT)
SIMPLE_MORPH(rpar_gt, SFT, &kp RPAR, &kp GT)
SIMPLE_MORPH(lpar_dllr,  SFT, &kp LPAR, &kp DLLR)
SIMPLE_MORPH(rpar_caret, SFT, &kp RPAR, &kp CARET)
SIMPLE_MORPH(lpar_caret,  SFT, &kp LPAR, &kp CARET)
SIMPLE_MORPH(rpar_dllr, SFT, &kp RPAR, &kp DLLR)

// TODO: figure out why i need this lol
SIMPLE_MORPH(ret, SFT, &kp RET, &kp LS(RET))

// ZMK_HOLD_TAP(lt_ret, bindings = <&mo>, <&kp RET>; flavor = "balanced";
//              tapping-term-ms = <200>; quick-tap-ms = <QUICK_TAP_MS>;)

// Tap: space | Shift + tap: dot -> space -> sticky shift | Hold: nav layer.
// NOTE: made the shift + tap work only when sticky shift, not when holding shift
// did this with new sentence layer
//
// ZMK_HOLD_TAP(lt_spc, bindings = <&mo>, <&spc_morph>; flavor = "balanced";
//              tapping-term-ms = <200>; quick-tap-ms = <QUICK_TAP_MS>;)
// SIMPLE_MORPH(spc_morph, SFT, &kp SPACE, &dot_spc)
SIMPLE_MORPH(dot_morph, SFT, &kp DOT, &kp DOT)
ZMK_MACRO(dot_spc_shft, bindings = <&dot_morph &kp SPACE &sk LSHFT>; wait-ms = <0>;
          tap-ms = <5>;)


// Tap: backspace | Lshft + tap: delete | Rshft + tap: shift-delete.
ZMK_MOD_MORPH(bs_del, bindings = <&kp BSPC>, <&kp DEL>;
              mods = <(MOD_LSFT|MOD_RSFT)>; keep-mods = <MOD_RSFT>;)

// Tap: copy | double-tap: cut.
ZMK_TAP_DANCE(copy_cut, bindings = <&kp LC(INS)>, <&kp LC(X)>;
              tapping-term-ms = <200>;)

// Sticky shift + leader.
ZMK_MACRO(leader_sft, bindings = <&sk LSHFT &leader>;)

// Underscore/snake_case word
SIMPLE_MORPH(under_snakeword, SFT, &kp UNDER, &snake_word SNAKE)

// Double dash
ZMK_MACRO(double_dash, bindings = <&kp MINUS &kp MINUS>;)

// Double dash help
ZMK_MACRO(dd_help, bindings = <&kp MINUS &kp MINUS &kp H &kp E &kp L &kp P>; wait-ms = <0>; tap-ms = <5>;)

// ans
ZMK_MACRO(ans, bindings = <&kp A &kp N &kp S>; wait-ms = <0>; tap-ms = <5>;)

// Misc aliases. [TODO: clean up]
#define CANCEL    &kp K_CANCEL            // Cancel caps-word & auto-layers.
#define DSK_PREV  &hmr LCTRL LG(LC(LEFT)) // Previous desktop.
#define DSK_NEXT  &hmr LALT LG(LC(RIGHT)) // Next     desktop.
#define PIN_WIN   &kp LG(LC(LS(Q)))       // Pin window across desktops.
#define PIN_APP   &kp LG(LC(LS(A)))       // Pin application across desktops.
#define DSK_MGR   &kp LA(GRAVE)           // Desktop manager.
#define VOL_DOWN  &hmr RSHFT C_VOL_DN

#define FN_RET FN RET // Tap: fn layer | Hold: return key.

/* Keymap */

// ZMK_CONDITIONAL_LAYER(sys, NAV FN, SYS)
ZMK_CONDITIONAL_LAYER(num_mirror, NUM MIRROR, NUM_MIRROR)

/ {
    conditional_layers {
        compatible = "zmk,conditional-layers";
        tri_layer {
            if-layers = <NAV FN>;
            then-layer = <SYS>;
        };
    };
};

#ifndef ZMK_BASE_LAYER
  #define ZMK_BASE_LAYER(name, LT, RT, LM, RM, LB, RB, LH, RH)                 \
      ZMK_LAYER(name, LT RT LM RM LB RB LH RH)
#endif

ZMK_BASE_LAYER(Base,
//╭─────────────┬─────────────┬─────────────┬─────────────┬─────────────┬─────────────╮ ╭─────────────┬─────────────┬─────────────┬─────────────┬─────────────────┬─────────────╮ 
    &kp TAB       &kp Q         &kp W         &kp E         &kp R         &kp T       ,   &kp Y         &kp U         &kp I         &kp O         &lt MOUSE_BTNS P  &kp BSPC    ,
//├─────────────┼─────────────┼─────────────┼─────────────┼─────────────┼─────────────┤ ├─────────────┼─────────────┼─────────────┼─────────────┼─────────────────┼─────────────┤ 
    &kp ESC       &hml LALT A   &hml2 LSHFT S &hml LCTRL D  &hml LGUI F  &kp G        ,   &kp H         &hmr RGUI J   &hmr RCTRL K &hmr RSHFT L   &hmr RALT SEMI    &kp SQT     , 
//├─────────────┼─────────────┼─────────────┼─────────────┼─────────────┼─────────────┤ ├─────────────┼─────────────┼─────────────┼─────────────┼─────────────────┼─────────────┤ 
    &kp DEL       &kp Z         &kp X         &kp C         &kp V         &kp B       ,   &kp COMMA     &kp N         &kp M         &kp DOT       &kp FSLH          &kp RET     , 
//╰─────────────┼─────────────┼─────────────┴─────────────┼─────────────┼─────────────┤ ├─────────────┼─────────────┼─────────────┴─────────────┼─────────────────┼─────────────╯ 
                                              SMART_NUM   &lt FN SPACE  &sl_fast MIRROR,  MAGIC_SHIFT  &lt NAV SPACE  &sl MIRROR           
//                                          ╰─────────────┴─────────────┴─────────────╯ ╰─────────────┴─────────────┴─────────────╯
)

ZMK_BASE_LAYER(Qwerty,
//╭─────────────┬─────────────┬─────────────┬─────────────┬─────────────┬─────────────╮ ╭─────────────┬─────────────┬─────────────┬─────────────┬─────────────┬─────────────╮ 
    ___            ___           ___           ___           ___           ___        ,   ___           ___           ___           ___           ___           ___         ,
//├─────────────┼─────────────┼─────────────┼─────────────┼─────────────┼─────────────┤ ├─────────────┼─────────────┼─────────────┼─────────────┼─────────────┼─────────────┤ 
    ___            &kp A         &kp S         &kp D         &kp F         ___        ,   ___           &kp J         &kp K         &kp L         &kp SEMI      ___         , 
//├─────────────┼─────────────┼─────────────┼─────────────┼─────────────┼─────────────┤ ├─────────────┼─────────────┼─────────────┼─────────────┼─────────────┼─────────────┤ 
    ___            ___           ___           ___           ___           ___        ,   ___           ___           ___           ___           ___           ___         ,
//╰─────────────┼─────────────┼─────────────┴─────────────┼─────────────┼─────────────┤ ├─────────────┼─────────────┼─────────────┴───────────────────────────┼─────────────╯ 
                                               ___           ___           ___        ,   ___           ___           ___ 
//                                          ╰─────────────┴─────────────┴─────────────╯ ╰─────────────┴─────────────┴─────────────╯
)

ZMK_BASE_LAYER(LeftShift,
//╭─────────────┬─────────────┬─────────────┬─────────────┬─────────────┬─────────────╮ ╭─────────────┬─────────────┬─────────────┬─────────────┬─────────────┬─────────────╮ 
    ___           ___           ___           ___           ___           ___         ,   ___           ___           ___           ___           ___           ___         ,
//├─────────────┼─────────────┼─────────────┼─────────────┼─────────────┼─────────────┤ ├─────────────┼─────────────┼─────────────┼─────────────┼─────────────┼─────────────┤ 
    ___           ___           ___           ___           ___           ___         ,   ___           ___           ___           ___           ___           ___         ,
//├─────────────┼─────────────┼─────────────┼─────────────┼─────────────┼─────────────┤ ├─────────────┼─────────────┼─────────────┼─────────────┼─────────────┼─────────────┤ 
    ___           ___           ___           ___           ___           ___         ,   ___           ___           ___           ___           ___           ___         ,
//╰─────────────┼─────────────┼─────────────┴─────────────┼─────────────┼─────────────┤ ├─────────────┼─────────────┼─────────────┴─────────────┼─────────────┼─────────────╯
                                              ___           ___           MAGIC_SHIFT ,   ___           ___          SMART_NUM
//                                          ╰─────────────┴─────────────┴─────────────╯ ╰─────────────┴─────────────┴─────────────╯
)

// TODO: LEFTSHIFT should only happen if num layer is being held, not if it's just tapped 
ZMK_BASE_LAYER(Num,
//╭─────────────┬────────────────────┬────────────────────────┬────────────────────┬──────────────────┬─────────────╮ ╭─────────────┬─────────────┬─────────────┬────────────┬─────────────┬─────────────╮ 
    ___           &kp N1               &kp N2                   &kp N3               &kp N4             &kp N5      ,   &kp N6        &kp N7        &kp N8        &kp N9    &lt MOUSE_BTNS N0 ___        ,
//├─────────────┼────────────────────┼────────────────────────┼────────────────────┼──────────────────┼─────────────┤ ├─────────────┼─────────────┼─────────────┼────────────┼─────────────┼─────────────┤ 
    ___           &hml LALT KP_SLASH   &hml LSHFT KP_ASTERISK   &hml LCTRL KP_MINUS  &hml LGUI KP_PLUS  &kp COLON   ,   &kp COLON    &hmr RGUI N4  &hmr RCTRL N5 &hmr RSHFT N6 &hmr RALT N0  ___         ,
//├─────────────┼────────────────────┼────────────────────────┼────────────────────┼──────────────────┼─────────────┤ ├─────────────┼─────────────┼─────────────┼────────────┼─────────────┼─────────────┤ 
  &tog_LEFTSHIFT  ___                  &kp PERIOD               &kp COMMA            &kp PERIOD         ___         ,   &ans          &kp N1        &kp N2        &kp N3       ___           ___         ,
//╰─────────────┼────────────────────┼────────────────────────┴────────────────────┼──────────────────┼─────────────┤ ├─────────────┼─────────────┴──────────────────────────┼─────────────┼─────────────╯ 
                                                                &tog_off_NUM         ___                ___         ,   ___           ___           &tog_off_NUM        
//                                                            ╰────────────────────┴──────────────────┴─────────────╯ ╰─────────────┴─────────────┴─────────────╯ 
)                
                 
ZMK_BASE_LAYER(Fn,
//╭───────────────┬────────────────┬─────────────────┬─────────────────┬────────────────┬──────────────╮ ╭─────────────┬─────────────┬─────────────┬─────────────┬─────────────┬─────────────╮ 
    &kp F1          &kp F2           &kp F3            &kp F4            &kp F5           &kp F6       ,   &kp F7      &hmr RGUI F8  &hmr RCTRL F9 &hmr RSHFT F10 &hmr RALT F11  &kp F12     , 
//├───────────────┼────────────────┼─────────────────┼─────────────────┼────────────────┼──────────────┤ ├─────────────┼─────────────┼─────────────┼─────────────┼─────────────┼─────────────┤ 
  &sl_slow ONESHOT &hml LALT C_MUTE  &hml LSHFT LEFT   &hml LCTRL UP     &hml LGUI DOWN   &kp RIGHT    ,   &kp K_APP     &mkp LCLK     &mkp RCLK     &kp KP_PLUS   VOL_DOWN      ___         , 
//├───────────────┼────────────────┼─────────────────┼─────────────────┼────────────────┼──────────────┤ ├─────────────┼─────────────┼─────────────┼─────────────┼─────────────┼─────────────┤ 
    &tog_QWERTY     &kp C_PREV       &kp C_PP          &kp C_NEXT        &kp C_VOL_DN     &kp C_VOL_UP ,   &kp K_APP    &kp C_BRI_DEC &kp C_BRI_INC  ___          &tog_on_MCRFT  &tog_on_GAME,
//╰───────────────┼────────────────┼─────────────────┴─────────────────┼────────────────┼──────────────┤ ├─────────────┼─────────────┼─────────────┴───────────────────────────┼─────────────╯ 
                                                       ___               ___              ___          ,   ___           ___           ___ 
//                                                   ╰─────────────────┴────────────────┴──────────────╯ ╰─────────────┴─────────────┴─────────────╯
)

ZMK_BASE_LAYER(Nav,
//╭─────────────┬────────────────┬─────────────────┬─────────────────┬────────────────┬─────────────╮ ╭─────────────┬─────────────┬─────────────┬─────────────┬─────────────┬─────────────╮ 
    ___           &kp LA(F4)       &kp LC(RIGHT)     &kp UP            &swapper         ___         ,   &kp LC(C)     ___           &kp HOME      ___           &kp LC(V)     NAV_DEL     , 
//├─────────────┼────────────────┼─────────────────┼─────────────────┼────────────────┼─────────────┤ ├─────────────┼─────────────┼─────────────┼─────────────┼─────────────┼─────────────┤ 
    ___           &hml LALT END    &hml LSHFT LEFT   &hml LCTRL DOWN   &hml LGUI RIGHT  ___         ,   NAV_LEFT      NAV_DOWN      NAV_UP        NAV_RIGHT     &kp RET       ___         , 
//├─────────────┼────────────────┼─────────────────┼─────────────────┼────────────────┼─────────────┤ ├─────────────┼─────────────┼─────────────┼─────────────┼─────────────┼─────────────┤ 
    &kp DEL       ___              ___               ___               ___              &kp LC(LEFT),   &kp INS       &kp PG_DN     &kp PG_UP     ___           ___           ___         , 
//╰─────────────┼────────────────┼─────────────────┴─────────────────┼────────────────┼─────────────┤ ├─────────────┼─────────────┼─────────────┴───────────────────────────┼─────────────╯ 
                                                     &tog_on_MOUSE     ___              ___         ,   ___          ___           CANCEL        
//                                                 ╰─────────────────┴────────────────┴─────────────╯ ╰─────────────┴─────────────┴─────────────╯
)

ZMK_BASE_LAYER(Sys,
//╭───────────────┬─────────────┬─────────────┬─────────────┬─────────────┬─────────────╮ ╭─────────────┬─────────────┬─────────────┬─────────────┬─────────────┬─────────────╮
    &bt BT_CLR     &bt BT_DISC 3 &bt BT_DISC 2 &bt BT_DISC 1 &bt BT_DISC 0  ___         ,   ___           ___           ___           ___           ___           ___         ,
//├───────────────┼─────────────┼─────────────┼─────────────┼─────────────┼─────────────┤ ├─────────────┼─────────────┼─────────────┼─────────────┼─────────────┼─────────────┤
    ___            &bt BT_SEL 3  &bt BT_SEL 2  &bt BT_SEL 1  &bt BT_SEL 0   ___         ,   &bootloader   ___           ___           ___           ___           ___         ,
//├───────────────┼─────────────┼─────────────┼─────────────┼─────────────┼─────────────┤ ├─────────────┼─────────────┼─────────────┼─────────────┼─────────────┼─────────────┤
    &bt BT_CLR_ALL  ___           ___           ___           ___           &sys_reset  ,   &sys_reset    ___           ___           ___           ___           ___         ,
//╰───────────────┼─────────────┼─────────────┴─────────────┼─────────────┼─────────────┤ ├─────────────┼─────────────┼─────────────┴───────────────────────────┼─────────────╯
                                                ___           ___           ___         ,   ___           ___           ___ 
//                                            ╰─────────────┴─────────────┴─────────────╯ ╰─────────────┴─────────────┴─────────────╯ 
)

ZMK_BASE_LAYER(Mouse,
//╭─────────────┬─────────────┬─────────────┬────────────────┬─────────────┬─────────────╮ ╭─────────────┬─────────────┬─────────────┬─────────────┬─────────────┬─────────────╮
    ___           ___           &kp PG_UP     U_MS_U           &kp PG_DN     ___         ,   ___           &kp PG_UP     U_MS_U         &kp PG_DN    ___           ___         ,
//├─────────────┼─────────────┼─────────────┼────────────────┼─────────────┼─────────────┤ ├─────────────┼─────────────┼─────────────┼─────────────┼─────────────┼─────────────┤
    ___           U_WH_L        U_MS_L        U_MS_D           U_MS_R        U_WH_R      ,   U_WH_L        U_MS_L        U_MS_D         U_MS_R       U_WH_R        ___         ,
//├─────────────┼─────────────┼─────────────┼────────────────┼─────────────┼─────────────┤ ├─────────────┼─────────────┼─────────────┼─────────────┼─────────────┼─────────────┤
    ___           ___           &mkp LCLK     &mkp MCLK        &mkp RCLK     ___         ,   ___           &mkp LCLK     &mkp MCLK      &mkp RCLK    ___           ___         ,
//╰─────────────┼─────────────┼─────────────┴────────────────┼─────────────┼─────────────┤ ├─────────────┼─────────────┼─────────────┴─────────────────────────────────────────╯
                                              &tog_off_MOUSE   ___           ___         ,   U_WH_D        ___           U_WH_U
//                                          ╰────────────────┴─────────────┴─────────────╯ ╰─────────────┴─────────────┴─────────────╯ 
)

ZMK_BASE_LAYER(Mouse_Btns,
//╭─────────────┬─────────────┬─────────────┬─────────────┬─────────────┬─────────────╮ ╭─────────────┬─────────────┬─────────────┬─────────────┬─────────────┬─────────────╮ 
    ___            ___           ___           ___           ___           ___        ,   ___           U_WH_D        U_WH_U        ___           ___           ___         ,
//├─────────────┼─────────────┼─────────────┼─────────────┼─────────────┼─────────────┤ ├─────────────┼─────────────┼─────────────┼─────────────┼─────────────┼─────────────┤ 
    ___            ___           ___           ___           ___           ___        ,   U_WH_L        &mkp LCLK     &mkp RCLK     U_WH_R        ___           ___         ,
//├─────────────┼─────────────┼─────────────┼─────────────┼─────────────┼─────────────┤ ├─────────────┼─────────────┼─────────────┼─────────────┼─────────────┼─────────────┤ 
    ___            ___           ___           ___           ___           ___        ,   ___           ___           ___           ___           ___           ___         ,
//╰─────────────┼─────────────┼─────────────┴─────────────┼─────────────┼─────────────┤ ├─────────────┼─────────────┼─────────────┴───────────────────────────┼─────────────╯ 
                                               ___           ___           ___        ,   ___           ___           ___ 
//                                          ╰─────────────┴─────────────┴─────────────╯ ╰─────────────┴─────────────┴─────────────╯
)

ZMK_BASE_LAYER(Mirror,
//╭─────────────┬─────────────┬─────────────┬─────────────┬─────────────┬─────────────╮ ╭─────────────┬─────────────┬─────────────┬─────────────┬─────────────┬─────────────╮ 
    &kp BSPC      &kp P         &kp O         &kp I         &kp U         &kp Y       ,   &kp T         &kp R         &kp E         &kp W         &kp Q         &kp TAB     , 
//├─────────────┼─────────────┼─────────────┼─────────────┼─────────────┼─────────────┤ ├─────────────┼─────────────┼─────────────┼─────────────┼─────────────┼─────────────┤ 
    &kp SQT      &hmr RALT SEMI &hmr RSHFT L &hmr RCTRL K  &hmr RGUI J   &kp H       ,   &kp G         &hml LGUI F   &hml LCTRL D  &hml LSHFT S &hml LALT A   &kp ESC     , 
//├─────────────┼─────────────┼─────────────┼─────────────┼─────────────┼─────────────┤ ├─────────────┼─────────────┼─────────────┼─────────────┼─────────────┼─────────────┤ 
    &kp RET       &kp FSLH      &kp DOT       &kp M         &kp N         &kp COMMA   ,   &kp B         &kp V         &kp C         &kp X         &kp Z         &kp DEL     , 
//╰─────────────┼─────────────┼─────────────┴─────────────┼─────────────┼─────────────┤ ├─────────────┼─────────────┼─────────────┴───────────────────────────┼─────────────╯ 
                                              SMART_NUM    &lt NAV SPACE   MAGIC_SHIFT ,   MAGIC_SHIFT  &lt FN SPACE  SMART_NUM           
//                                          ╰─────────────┴─────────────┴─────────────╯ ╰─────────────┴─────────────┴─────────────╯
)

ZMK_BASE_LAYER(Num_Mirror,
//╭─────────────┬────────────────────┬──────────────────┬─────────────────┬──────────────┬─────────────╮ ╭─────────────┬─────────────┬─────────────┬────────────┬─────────────────┬─────────────╮ 
    ___           ___                  &kp N7             &kp N8            &kp N9         &kp N0      ,   &kp N6        &kp N7        &kp N8        &kp N9      &lt MOUSE_BTNS N0  ___         ,
//├─────────────┼────────────────────┼──────────────────┼─────────────────┼──────────────┼─────────────┤ ├─────────────┼─────────────┼─────────────┼────────────┼─────────────────┼─────────────┤ 
    ___           &hml LALT N0         &hml LSHFT N4      &hml LCTRL N5     &hml LGUI N6   ___         ,   &kp COLON    &hmr RGUI N7  &hmr RCTRL N8 &hmr RSHFT N9 &hmr RALT N0      ___         ,
//├─────────────┼────────────────────┼──────────────────┼─────────────────┼──────────────┼─────────────┤ ├─────────────┼─────────────┼─────────────┼────────────┼─────────────────┼─────────────┤ 
    ___           ___                  &kp N1             &kp N2            &kp N3         &kp PERIOD  ,   ___           &kp N1        &kp N2        &kp N3       ___               ___         ,
//╰─────────────┼────────────────────┼──────────────────┴─────────────────┼──────────────┼─────────────┤ ├─────────────┼─────────────┴──────────────────────────┼─────────────────┼─────────────╯ 
                                                         &tog_off_NUM       ___            ___         ,   ___           ___          &tog_off_NUM        
//                                                      ╰─────────────────┴──────────────┴─────────────╯ ╰─────────────┴─────────────┴─────────────╯ 
)                

ZMK_BASE_LAYER(Oneshot,
//╭─────────────┬─────────────┬─────────────┬─────────────┬─────────────┬─────────────╮ ╭─────────────┬─────────────┬─────────────┬─────────────┬─────────────┬─────────────╮ 
    ___            ___           ___           ___           ___           ___        ,   ___           ___           ___           ___           ___           ___         ,
//├─────────────┼─────────────┼─────────────┼─────────────┼─────────────┼─────────────┤ ├─────────────┼─────────────┼─────────────┼─────────────┼─────────────┼─────────────┤ 
    ___            &sk LALT      &sk LSHFT     &sk LCTRL     &sk LGUI      ___        ,   ___           &sk RGUI      &sk RCTRL     &sk RSHFT     &sk RALT      ___         , 
//├─────────────┼─────────────┼─────────────┼─────────────┼─────────────┼─────────────┤ ├─────────────┼─────────────┼─────────────┼─────────────┼─────────────┼─────────────┤ 
    ___            ___           ___           ___           ___           ___        ,   ___           ___           ___           ___           ___           ___         ,
//╰─────────────┼─────────────┼─────────────┴─────────────┼─────────────┼─────────────┤ ├─────────────┼─────────────┼─────────────┴───────────────────────────┼─────────────╯ 
                                               ___           ___           ___        ,   ___           ___           ___ 
//                                          ╰─────────────┴─────────────┴─────────────╯ ╰─────────────┴─────────────┴─────────────╯
)

ZMK_BASE_LAYER(Snake,
//╭─────────────┬─────────────┬─────────────┬─────────────┬─────────────┬─────────────╮ ╭─────────────┬─────────────┬─────────────┬─────────────┬─────────────┬─────────────╮ 
    ___            ___           ___           ___           ___           ___        ,   ___           ___           ___           ___           ___           ___         ,
//├─────────────┼─────────────┼─────────────┼─────────────┼─────────────┼─────────────┤ ├─────────────┼─────────────┼─────────────┼─────────────┼─────────────┼─────────────┤ 
    ___            ___           ___           ___           ___           ___        ,   ___           ___           ___           ___           ___           ___         ,
//├─────────────┼─────────────┼─────────────┼─────────────┼─────────────┼─────────────┤ ├─────────────┼─────────────┼─────────────┼─────────────┼─────────────┼─────────────┤ 
    ___            ___           ___           ___           ___           ___        ,   ___           ___           ___           ___           ___           ___         ,
//╰─────────────┼─────────────┼─────────────┴─────────────┼─────────────┼─────────────┤ ├─────────────┼─────────────┼─────────────┴───────────────────────────┼─────────────╯ 
                                               ___         &lt FN UNDER     ___        ,   ___          ___           ___ 
//                                          ╰─────────────┴─────────────┴─────────────╯ ╰─────────────┴─────────────┴─────────────╯
)

ZMK_BASE_LAYER(NoIdle,
//╭─────────────┬─────────────┬─────────────┬─────────────┬─────────────┬─────────────╮ ╭─────────────┬─────────────┬─────────────┬─────────────┬─────────────┬─────────────╮ 
    ___            ___           ___           ___           ___           ___        ,   ___           ___           ___           ___           ___           ___         ,
//├─────────────┼─────────────┼─────────────┼─────────────┼─────────────┼─────────────┤ ├─────────────┼─────────────┼─────────────┼─────────────┼─────────────┼─────────────┤ 
___ &hml_no_idle LALT A  &hml_no_idle LSHFT S  &hml_no_idle LCTRL D  &hml_no_idle LGUI F ___, ___ &hmr_no_idle RGUI J  &hmr_no_idle RCTRL K  &hmr_no_idle RSHFT L  &hmr_no_idle RALT SEMI ___, 
//├─────────────┼─────────────┼─────────────┼─────────────┼─────────────┼─────────────┤ ├─────────────┼─────────────┼─────────────┼─────────────┼─────────────┼─────────────┤ 
    ___            ___           ___           ___           ___           ___        ,   ___           ___           ___           ___           ___           ___         ,
//╰─────────────┼─────────────┼─────────────┴─────────────┼─────────────┼─────────────┤ ├─────────────┼─────────────┼─────────────┴───────────────────────────┼─────────────╯ 
                                               ___           ___           ___        ,   ___           ___           ___ 
//                                          ╰─────────────┴─────────────┴─────────────╯ ╰─────────────┴─────────────┴─────────────╯
)

ZMK_BASE_LAYER(Sentence,
//╭─────────────┬─────────────┬─────────────┬─────────────┬─────────────┬─────────────╮ ╭─────────────┬─────────────┬─────────────┬─────────────┬─────────────┬─────────────╮ 
    ___           ___           ___           ___           ___           ___         ,   ___           ___           ___           ___           ___           ___         ,
//├─────────────┼─────────────┼─────────────┼─────────────┼─────────────┼─────────────┤ ├─────────────┼─────────────┼─────────────┼─────────────┼─────────────┼─────────────┤ 
    ___           ___           ___           ___           ___           ___         ,   ___           ___           ___           ___           ___           ___         ,
//├─────────────┼─────────────┼─────────────┼─────────────┼─────────────┼─────────────┤ ├─────────────┼─────────────┼─────────────┼─────────────┼─────────────┼─────────────┤ 
    ___           ___           ___           ___           ___           ___         ,   ___           ___           ___           ___           ___           ___         ,
//╰─────────────┼─────────────┼─────────────┴─────────────┼─────────────┼─────────────┤ ├─────────────┼─────────────┼─────────────┴───────────────────────────┼─────────────╯ 
                                              ___          &dot_spc_shft  ___         ,   ___           ___           ___ 
//                                          ╰─────────────┴─────────────┴─────────────╯ ╰─────────────┴─────────────┴─────────────╯
)

ZMK_BASE_LAYER(Game,
//╭─────────────┬─────────────┬─────────────┬─────────────┬─────────────┬─────────────╮ ╭─────────────┬─────────────┬─────────────┬─────────────┬─────────────┬─────────────╮ 
    &kp TAB       &kp T         &kp Q         &kp W         &kp E         &kp R       ,   &kp F1        &kp F2        &kp F3        &kp F5        &kp F11      &tog_off_GAME,
//├─────────────┼─────────────┼─────────────┼─────────────┼─────────────┼─────────────┤ ├─────────────┼─────────────┼─────────────┼─────────────┼─────────────┼─────────────┤ 
    &kp ESC       &kp LSHFT     &kp A         &kp S         &kp D         &kp F       ,  &tog_off_GAME &tog_off_GAME &tog_off_GAME &tog_off_GAME &tog_off_GAME &tog_off_GAME,
//├─────────────┼─────────────┼─────────────┼─────────────┼─────────────┼─────────────┤ ├─────────────┼─────────────┼─────────────┼─────────────┼─────────────┼─────────────┤ 
    &kp LALT      &kp LCTRL     &kp Z         &kp X         &kp C         &kp V       ,  &tog_off_GAME &tog_off_GAME &tog_off_GAME &tog_off_GAME &tog_off_GAME &tog_off_GAME,
//╰─────────────┼─────────────┼─────────────┴─────────────┼─────────────┼─────────────┤ ├─────────────┼─────────────┼─────────────┴─────────────┼─────────────┼─────────────╯ 
                                             &tog_off_GAME  &kp SPACE     &sl GAME_NUM,  &tog_off_GAME &tog_off_GAME &tog_off_GAME
//                                          ╰─────────────┴─────────────┴─────────────╯ ╰─────────────┴─────────────┴─────────────╯
)


ZMK_BASE_LAYER(Mcrft,
//╭─────────────┬─────────────┬─────────────┬─────────────┬─────────────┬─────────────╮ ╭───────────────┬───────────────┬───────────────┬───────────────┬───────────────┬───────────────╮ 
    &kp TAB       &kp T         &kp Q         &kp W         &kp E         &kp R       ,   &kp F1          &kp F2          &kp F3          &kp F5          &kp F11         &tog_off_MCRFT,
//├─────────────┼─────────────┼─────────────┼─────────────┼─────────────┼─────────────┤ ├───────────────┼───────────────┼───────────────┼───────────────┼───────────────┼───────────────┤ 
    &kp ESC       &kp LSHFT     &kp A         &kp S         &kp D         &kp F       ,   &tog_off_MCRFT  &tog_off_MCRFT  &tog_off_MCRFT  &tog_off_MCRFT  &tog_off_MCRFT  &tog_off_MCRFT,
//├─────────────┼─────────────┼─────────────┼─────────────┼─────────────┼─────────────┤ ├───────────────┼───────────────┼───────────────┼───────────────┼───────────────┼───────────────┤ 
    &kp LALT      &kp LCTRL     &kp N1        &kp N2        &kp N3        &kp N4      ,   &tog_off_MCRFT  &tog_off_MCRFT  &tog_off_MCRFT  &tog_off_MCRFT  &tog_off_MCRFT  &tog_off_MCRFT,
//╰─────────────┼─────────────┼─────────────┴─────────────┼─────────────┼─────────────┤ ├───────────────┼───────────────┼───────────────┼───────────────┴───────────────┴───────────────╯ 
                                             &tog_off_MCRFT &kp SPACE     &sl GAME_NUM,   &tog_off_MCRFT  &tog_off_MCRFT  &tog_off_MCRFT
//                                          ╰─────────────┴─────────────┴─────────────╯ ╰───────────────┴───────────────┴───────────────╯
)

ZMK_BASE_LAYER(Game_Num,
//╭─────────────┬─────────────┬─────────────┬─────────────┬─────────────┬─────────────╮ ╭─────────────┬─────────────┬─────────────┬─────────────┬─────────────┬─────────────╮ 
    ___           &kp N6        &kp N7        &kp N8        &kp N9        &kp N0      ,   ___           ___           ___           ___           ___           ___        ,
//├─────────────┼─────────────┼─────────────┼─────────────┼─────────────┼─────────────┤ ├─────────────┼─────────────┼─────────────┼─────────────┼─────────────┼─────────────┤ 
    ___           &kp N1        &kp N2        &kp N3        &kp N4        &kp N5      ,   ___           ___           ___           ___           ___           ___        ,
//├─────────────┼─────────────┼─────────────┼─────────────┼─────────────┼─────────────┤ ├─────────────┼─────────────┼─────────────┼─────────────┼─────────────┼─────────────┤ 
    ___           ___           &kp F1        &kp F2        &kp F3        &kp F11     ,   ___           ___           ___           ___           ___           ___        ,
//╰─────────────┼─────────────┼─────────────┴─────────────┼─────────────┼─────────────┤ ├─────────────┼─────────────┼─────────────┴─────────────┼─────────────┼─────────────╯ 
                                              ___           ___           ___         ,   ___           ___           ___
//                                          ╰─────────────┴─────────────┴─────────────╯ ╰─────────────┴─────────────┴─────────────╯
)

// ZMK_BASE_LAYER(Combos,
// //╭─────────────┬─────────────┬─────────────┬─────────────┬─────────────┬─────────────╮ ╭───────────────┬───────────────┬───────────────┬───────────────┬───────────────┬───────────────╮ 
//     ___           ___           ___           ___           ___           ___         ,   ___             ___             ___             ___             ___             ___           ,
// //├─────────────┼─────────────┼─────────────┼─────────────┼─────────────┼─────────────┤ ├───────────────┼───────────────┼───────────────┼───────────────┼───────────────┼───────────────┤ 
//     ___           ___           ___           ___           ___           ___         ,   ___             ___             ___             ___             ___             ___           ,
// //├─────────────┼─────────────┼─────────────┼─────────────┼─────────────┼─────────────┤ ├───────────────┼───────────────┼───────────────┼───────────────┼───────────────┼───────────────┤ 
//     ___           ___           ___           ___           ___           ___         ,   ___             ___             ___             ___             ___             ___           ,
// //╰─────────────┼─────────────┼─────────────┴─────────────┼─────────────┼─────────────┤ ├───────────────┼───────────────┼───────────────┼───────────────┴───────────────┴───────────────╯ 
//                                               ___           ___           ___         ,   ___             ___             ___      
// //                                          ╰─────────────┴─────────────┴─────────────╯ ╰───────────────┴───────────────┴───────────────╯
// )



// ZMK_BASE_LAYER(Combos, 
// ___            ___           ___           ___           ___           ___      ,     ___           ___           ___           ___           ___           ___          ,
// ___            ___           ___           ___           ___           ___      ,     ___           ___           ___           ___           ___           ___          ,
// ___            ___           ___           ___           ___           ___      ,     ___           ___           ___           ___           ___           ___          ,
//                                            ___           ___           ___      ,     ___           ___           ___ 
// )


// ZMK_BASE_LAYER(Num,
// //╭─────────────┬─────────────┬─────────────┬─────────────┬─────────────┬─────────────╮ ╭─────────────┬─────────────┬─────────────┬─────────────┬─────────────┬─────────────╮ 
//     // ___           ___           &kp N7        &kp N8        &kp N9        ___         ,   ___           ___           ___           ___           ___           ___         , 
//     // ___           &kp EXCL      &kp AT        &kp HASH      &kp DLLR      &kp PERC    ,   &kp CIRC      &kp AMPS      &kp ASTRK     &kp LPRN      &kp RPRN      ___         ,
//     ___           &kp EXCL      &kp AT        &kp HASH      &kp DLLR      &kp PERCENT    ,   &kp CARET      &kp AMPS      &kp ASTRK     &kp LPAR      &kp RPAR      ___         ,
//         // ___            ___           ___           ___           ___           ___      ,     ___           ___           ___           ___           ___           ___          ,
// //├─────────────┼─────────────┼─────────────┼─────────────┼─────────────┼─────────────┤ ├─────────────┼─────────────┼─────────────┼─────────────┼─────────────┼─────────────┤ 
//     ___           &hml LALT N1 &hml2 LSHFT N2 &hml LCTRL N3  &hml LGUI N4  &kp N5      ,   &kp N6        &hmr RGUI N7 &hmr RCTRL N8 &hml2 RSHFT N9  &hmr RALT N0  ___         ,
// //├─────────────┼─────────────┼─────────────┼─────────────┼─────────────┼─────────────┤ ├─────────────┼─────────────┼─────────────┼─────────────┼─────────────┼─────────────┤ 
//     ___           ___           &kp N1        &kp N2        &kp N3        ___         ,   ___           ___           ___           ___           ___           ___         , 
// //╰─────────────┼─────────────┼─────────────┴─────────────┼─────────────┼─────────────┤ ├─────────────┼─────────────┼─────────────┴───────────────────────────┼─────────────╯ 
//                                               ___           ___           ___         ,   ___           ___            ___        
// //                                          ╰─────────────┴─────────────┴─────────────╯ ╰─────────────┴─────────────┴─────────────╯ 
// )



// ZMK_BASE_LAYER(Sys,
// //╭─────────────┬─────────────┬─────────────┬─────────────┬─────────────┬─────────────╮ ╭─────────────┬─────────────┬─────────────┬─────────────┬─────────────┬─────────────╮
//     ___                                      _BT_SEL_KEYS_                            ,   ___           ___           ___           ___           ___           ___         ,
// //├─────────────┼─────────────┼─────────────┼─────────────┼─────────────┼─────────────┤ ├─────────────┼─────────────┼─────────────┼─────────────┼─────────────┼─────────────┤
//     ___           ___           ___           ___           ___           &bootloader ,   &bootloader   ___           ___           ___           ___           ___         ,
// //├─────────────┼─────────────┼─────────────┼─────────────┼─────────────┼─────────────┤ ├─────────────┼─────────────┼─────────────┼─────────────┼─────────────┼─────────────┤
//    &bt BT_CLR_ALL ___           ___           ___           ___           &sys_reset  ,   &sys_reset    ___           ___           ___           ___           ___         ,
// //╰─────────────┼─────────────┼─────────────┴─────────────┼─────────────┼─────────────┤ ├─────────────┼─────────────┼─────────────┴───────────────────────────┼─────────────╯
//                                                  ___           ___           ___      ,     ___           ___           ___ 
//                                               // ___           ___           ___         ,   ___           &tog SYS      ___        
// //                                          ╰─────────────┴─────────────┴─────────────╯ ╰─────────────┴─────────────┴─────────────╯ 
// )



// ZMK_BASE_LAYER(Qwerty,
// //╭─────────────┬─────────────┬─────────────┬─────────────┬─────────────┬─────────────╮ ╭─────────────┬─────────────┬─────────────┬─────────────┬─────────────┬─────────────╮ 
//     &kp TAB       &kp Q         &kp W         &kp E         &kp R         &kp T       ,   &kp Y         &kp U         &kp I         &kp O         &kp P         &kp BSPC    , 
// //├─────────────┼─────────────┼─────────────┼─────────────┼─────────────┼─────────────┤ ├─────────────┼─────────────┼─────────────┼─────────────┼─────────────┼─────────────┤ 
//     &kp ESC       &kp A         &kp S         &kp D         &kp F         &kp G       ,   &kp H         &kp J         &kp K         &kp L         &kp SEMI      &kp SQT     , 
// //├─────────────┼─────────────┼─────────────┼─────────────┼─────────────┼─────────────┤ ├─────────────┼─────────────┼─────────────┼─────────────┼─────────────┼─────────────┤ 
//     &kp LSHFT     &kp Z         &kp X         &kp C         &kp V         &kp B       ,   &kp COMMA     &kp N         &kp M         &kp DOT       &kp FSLH      &kp RET     , 
// //╰─────────────┼─────────────┼─────────────┴─────────────┼─────────────┼─────────────┤ ├─────────────┼─────────────┼─────────────┴───────────────────────────┼─────────────╯ 
//                                               SMART_NUM     &lt_spc FN 0  MAGIC_SHIFT ,   MAGIC_SHIFT  &lt_spc NAV 0  SMART_NUM           
// //                                          ╰─────────────┴─────────────┴─────────────╯ ╰─────────────┴─────────────┴─────────────╯
// )

/* vim: set ft=c tw=146: */
